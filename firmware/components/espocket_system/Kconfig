## firmware/components/espocket_system/Kconfig
```kconfig
menu "ESPocket"

    config ESPOCKET_PRODUCT_CJK_FONT
        bool
        default y
        select LV_USE_TINY_TTF

    config ESPOCKET_PACKAGE_ACCEPTANCE_TEST
        bool "Test only: run signed package and Developer Mode acceptance"
        default n
        help
            Uses public fixture inputs, the real Core APIs and the real mode
            control. Updates and uninstalls only espocket.test.store_hello,
            checks an installed Flappy Bird across mode changes, restores the
            initial mode, and performs two controlled resets. Never enable in
            production firmware. Does not add USB installation commands.

    config ESPOCKET_PACKAGE_ACCEPTANCE_INPUTS
        string "External directory containing package_acceptance_inputs.hpp"
        depends on ESPOCKET_PACKAGE_ACCEPTANCE_TEST
        default ""

    config ESPOCKET_M2_LIFECYCLE_STRESS
        bool "Run the M2 Native App lifecycle stress test at boot"
        default n
        help
            Start and stop Hello Native 50 times before starting Circular Shell.
            This emits deterministic lifecycle and heap samples for M2 acceptance
            and must remain disabled in normal interactive firmware builds.

    config ESPOCKET_M6_SCREEN_TIMEOUT_SECONDS
        int "M6 global screen timeout in seconds"
        range 0 3600
        default 30
        help
            Turn the display off after this many seconds without touch input.
            Set to 0 for the global Never setting. Apps cannot override it.

    config ESPOCKET_M6_RECLAIM_ON_TIMEOUT_TEST
        bool "M6 test: stop the foreground App after automatic screen-off"
        default n
        help
            Test firmware only. After automatic screen-off with a visible App,
            stop that App through System Core to invalidate the saved resume
            target. The next PWR wake must show Watch Face without restarting
            the App. Leave disabled in normal interactive firmware.

    config ESPOCKET_M8_CARD_SAMPLE_TEST
        bool "M8 test: show Native/Runtime Card samples with a temporary configuration"
        default n
        help
            With persisted Developer Mode enabled and an empty restored Card
            configuration, place Native summary/detail on the left and Runtime
            summary/detail on the right. This fixture is RAM only, not a Card
            editor and never writes NVS. Leave disabled in normal firmware.

    config ESPOCKET_M8_RECLAIM_NATIVE_TEST
        bool "M8 test: reclaim only Native Apps after automatic screen-off"
        default n
        help
            Stop only the visible Native resume target through System Core.
            Runtime Apps retain their current Page. Old Page/Back/keyboard
            resources follow ordinary Core stop cleanup. Wake shows Watch Face;
            a later user launch starts at Root. Leave disabled in normal firmware.

    config ESPOCKET_M8_RECLAIM_RUNTIME_TEST
        bool "M8 test: reclaim only Runtime Apps after automatic screen-off"
        default n
        help
            Stop only the visible Runtime resume target through System Core.
            Native Apps retain their current Page. This is a bounded test seam,
            not a low-memory killer or a new USB command. Leave disabled normally.

    config ESPOCKET_M6_RESOURCE_TRACE
        bool "M6 test: log heap at Watch Face before PWR screen-off"
        default n
        help
            Test firmware only. Emit internal and PSRAM free/largest heap
            metrics at a repeatable Watch Face checkpoint after each App Home
            transition. Leave disabled in normal interactive firmware.

    config ESPOCKET_RUNTIME_IMAGE_CACHE_BYTES
        int "Bounded LVGL decoded image cache in bytes"
        range 0 2097152
        default 524288
        help
            The validated default is 512 KiB; zero disables retained decoding.
            Decoded buffers use the upstream allocator (prefers PSRAM).
            Oversized images bypass the cache and PNG decoding releases
            retained entries under memory pressure. This budget excludes
            decoder workspace and buffers currently in use.

    config ESPOCKET_RUNTIME_RENDER_PROFILE
        bool "Measure Runtime PNG misses, drawing and completed refresh FPS"
        default n
        select ESP_LVGL_ADAPTER_ENABLE_FPS_STATS
        help
            Diagnostic only: aggregate two-second windows, never log image
            bytes or game state. Counts successful real PNG decoder opens,
            render duration and adapter completed-frame FPS. Leave off normally.

endmenu
```

## firmware/components/espocket_system/Kconfig.projbuild
```kconfig
menu "ESPocket"

    config ESPOCKET_M2_LIFECYCLE_STRESS
        bool "Run the M2 Native App lifecycle stress test at boot"
        default n
        help
            Start and stop Hello Native 50 times before starting Circular Shell.
            This emits deterministic lifecycle and heap samples for M2 acceptance
            and must remain disabled in normal interactive firmware builds.

    config ESPOCKET_M6_SCREEN_TIMEOUT_SECONDS
        int "M6 global screen timeout in seconds"
        range 0 3600
        default 30
        help
            Turn the display off after this many seconds without touch input.
            Set to 0 for the global Never setting. Apps cannot override it.

endmenu
```
